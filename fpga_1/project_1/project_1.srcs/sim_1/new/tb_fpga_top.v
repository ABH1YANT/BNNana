`timescale 1ns / 1ps

module tb_fpga_top;

    // ============================================================
    // FAST SIMULATION PARAMETERS
    // ============================================================

    localparam CLK_FREQ  = 10_000_000;
    localparam BAUD_RATE = 2_000_000;

    localparam CLKS_PER_BIT = CLK_FREQ / BAUD_RATE;


    // ============================================================
    // CLOCK / RESET
    // ============================================================

    reg clk;
    reg rst;

    reg  uart_rx_pin;
    wire uart_tx_pin;


    // ============================================================
    // TEST COUNTERS
    // ============================================================

    integer pass_count;
    integer fail_count;


    // ============================================================
    // RECEIVED RESULT
    // ============================================================

    reg [7:0] received_result;


    // ============================================================
    // DUT
    // ============================================================

    fpga_top #(
        .CLK_FREQ(CLK_FREQ),
        .BAUD_RATE(BAUD_RATE)
    ) dut (
        .clk(clk),
        .rst(rst),

        .uart_rx_pin(uart_rx_pin),
        .uart_tx_pin(uart_tx_pin)
    );


    // ============================================================
    // CLOCK
    // 10 MHz = 100 ns period
    // ============================================================

    always #50 clk = ~clk;


    // ============================================================
    // CHECK TASK
    // ============================================================

    task check;
        input condition;
        input [255:0] message;

        begin
            if (condition) begin
                $display("%s: PASS", message);
                pass_count = pass_count + 1;
            end
            else begin
                $display("%s: FAIL", message);
                fail_count = fail_count + 1;
            end
        end
    endtask


    // ============================================================
    // UART SEND BYTE
    //
    // 8N1:
    //
    // 1 start bit
    // 8 data bits, LSB first
    // 1 stop bit
    // ============================================================

    task uart_send_byte;

        input [7:0] data;

        integer k;

        begin

            // ----------------------------------------------------
            // START BIT
            // ----------------------------------------------------

            uart_rx_pin = 1'b0;

            repeat (CLKS_PER_BIT)
                @(posedge clk);


            // ----------------------------------------------------
            // DATA BITS
            // ----------------------------------------------------

            for (k = 0; k < 8; k = k + 1) begin

                uart_rx_pin = data[k];

                repeat (CLKS_PER_BIT)
                    @(posedge clk);

            end


            // ----------------------------------------------------
            // STOP BIT
            // ----------------------------------------------------

            uart_rx_pin = 1'b1;

            repeat (CLKS_PER_BIT)
                @(posedge clk);

        end

    endtask


    // ============================================================
    // WAIT FOR TX START BIT
    // ============================================================

    task wait_for_tx_start;

        integer timeout;

        begin

            timeout = 0;

            while ((uart_tx_pin !== 1'b0) &&
                   (timeout < 200)) begin

                @(posedge clk);

                timeout = timeout + 1;

            end


            if (uart_tx_pin === 1'b0) begin

                $display("UART TX START DETECTED: PASS");
                pass_count = pass_count + 1;

            end
            else begin

                $display("UART TX START DETECTED: FAIL");
                fail_count = fail_count + 1;

            end

        end

    endtask


    // ============================================================
    // RECEIVE ONE UART BYTE
    // ============================================================

    task uart_receive_byte;

        output [7:0] data;

        integer k;

        begin

            data = 8'h00;


            // ----------------------------------------------------
            // We are currently at the beginning of the START bit.
            //
            // Wait 1.5 bit periods to reach the middle of
            // DATA BIT 0.
            // ----------------------------------------------------

            repeat (CLKS_PER_BIT + CLKS_PER_BIT/2)
                @(posedge clk);


            // ----------------------------------------------------
            // DATA BITS
            // ----------------------------------------------------

            for (k = 0; k < 8; k = k + 1) begin

                data[k] = uart_tx_pin;

                repeat (CLKS_PER_BIT)
                    @(posedge clk);

            end


            // ----------------------------------------------------
            // STOP BIT
            // ----------------------------------------------------

            check(
                uart_tx_pin === 1'b1,
                "UART TX STOP BIT"
            );

        end

    endtask


    // ============================================================
    // MAIN TEST
    // ============================================================

    initial begin

        clk = 1'b0;
        rst = 1'b1;

        // UART idle state
        uart_rx_pin = 1'b1;

        pass_count = 0;
        fail_count = 0;

        received_result = 8'h00;


        // ========================================================
        // RESET
        // ========================================================

        #500;

        @(negedge clk);
        rst = 1'b0;

        #500;


        // ========================================================
        // SEND COMPLETE PACKET
        //
        // HEADER
        // 43 PAYLOAD BYTES
        // FOOTER
        //
        // This is the same verified packet used earlier.
        // Expected classification = 0.
        // ========================================================

        $display("");
        $display("==============================================");
        $display("END-TO-END TEST");
        $display("==============================================");

        $display("");
        $display("Sending packet...");


        // --------------------------------------------------------
        // HEADER
        // --------------------------------------------------------

        uart_send_byte(8'hAA);


        // --------------------------------------------------------
        // F0 = 12000
        // 0x2EE0
        // --------------------------------------------------------

        uart_send_byte(8'hE0);
        uart_send_byte(8'h2E);


        // --------------------------------------------------------
        // F1 = 1472
        // 0x05C0
        // --------------------------------------------------------

        uart_send_byte(8'hC0);
        uart_send_byte(8'h05);


        // --------------------------------------------------------
        // F2 = 16777216
        // 0x01000000
        // --------------------------------------------------------

        uart_send_byte(8'h00);
        uart_send_byte(8'h00);
        uart_send_byte(8'h00);
        uart_send_byte(8'h01);


        // --------------------------------------------------------
        // F3 = 12345678
        // 0x00BC614E
        // --------------------------------------------------------

        uart_send_byte(8'h4E);
        uart_send_byte(8'h61);
        uart_send_byte(8'hBC);
        uart_send_byte(8'h00);


        // --------------------------------------------------------
        // F4 = 65535
        // 0xFFFF
        // --------------------------------------------------------

        uart_send_byte(8'hFF);
        uart_send_byte(8'hFF);


        // --------------------------------------------------------
        // F5 = 1480
        // 0x05C8
        // --------------------------------------------------------

        uart_send_byte(8'hC8);
        uart_send_byte(8'h05);


        // --------------------------------------------------------
        // F6 = 1
        // --------------------------------------------------------

        uart_send_byte(8'h01);


        // --------------------------------------------------------
        // F7 = 100000
        // 0x0186A0
        // --------------------------------------------------------

        uart_send_byte(8'hA0);
        uart_send_byte(8'h86);
        uart_send_byte(8'h01);


        // --------------------------------------------------------
        // F8 = 23360
        // 0x5B40
        // --------------------------------------------------------

        uart_send_byte(8'h40);
        uart_send_byte(8'h5B);


        // --------------------------------------------------------
        // F9 = 99999
        // 0x01869F
        // --------------------------------------------------------

        uart_send_byte(8'h9F);
        uart_send_byte(8'h86);
        uart_send_byte(8'h01);


        // --------------------------------------------------------
        // F10 = 1323378
        // 0x143172
        // --------------------------------------------------------

        uart_send_byte(8'h72);
        uart_send_byte(8'h31);
        uart_send_byte(8'h14);


        // --------------------------------------------------------
        // F11 = 23360
        // 0x5B40
        // --------------------------------------------------------

        uart_send_byte(8'h40);
        uart_send_byte(8'h5B);


        // --------------------------------------------------------
        // F12 = 1000000
        // 0x0F4240
        // --------------------------------------------------------

        uart_send_byte(8'h40);
        uart_send_byte(8'h42);
        uart_send_byte(8'h0F);


        // --------------------------------------------------------
        // F13 = 1048576
        // 0x100000
        // --------------------------------------------------------

        uart_send_byte(8'h00);
        uart_send_byte(8'h00);
        uart_send_byte(8'h10);


        // --------------------------------------------------------
        // F14 = 119999877
        // 0x07270D85
        // --------------------------------------------------------

        uart_send_byte(8'h85);
        uart_send_byte(8'h0D);
        uart_send_byte(8'h27);
        uart_send_byte(8'h07);


        // --------------------------------------------------------
        // F15 = 1048576
        // 0x100000
        // --------------------------------------------------------

        uart_send_byte(8'h00);
        uart_send_byte(8'h00);
        uart_send_byte(8'h10);


        // --------------------------------------------------------
        // FOOTER
        // --------------------------------------------------------

        uart_send_byte(8'h55);


        $display("Packet sent.");


        // ========================================================
        // WAIT FOR CLASSIFICATION
        // ========================================================

        $display("");
        $display("Waiting for FPGA classification...");


        wait_for_tx_start;


        // ========================================================
        // RECEIVE CLASSIFICATION
        // ========================================================

        uart_receive_byte(received_result);


        $display(
            "Received classification = 0x%02X",
            received_result
        );


        // ========================================================
        // EXPECTED RESULT
        // ========================================================

        check(
            received_result === 8'h00,
            "FINAL CLASSIFICATION = 0"
        );


        // ========================================================
        // FINAL
        // ========================================================

        #500;

        $display("");
        $display("==============================================");
        $display("END-TO-END TEST RESULT");
        $display("==============================================");
        $display("PASS = %0d", pass_count);
        $display("FAIL = %0d", fail_count);
        $display("==============================================");

        if (fail_count == 0)
            $display("FULL FPGA TOP TEST PASSED");
        else
            $display("FULL FPGA TOP TEST FAILED");


        $finish;

    end

endmodule